## west.yml
```yaml
# The west manifest file for rt595 microej

manifest:
  remotes:
    - name: nxp-mcuxpresso
      url-base: https://github.com/nxp-mcuxpresso
  # Please add items below in reverse alphabetical order
  projects:
    - name: mcux-sdk
      remote: nxp-mcuxpresso
      revision: 5fb76f2d51ac20
      path: nxp-vee-rt595/bsp/mcux-sdk/core
    - name: CMSIS_5
      revision: MCUX_2.15.000
      remote: nxp-mcuxpresso
      path: nxp-vee-rt595/bsp/mcux-sdk/core/CMSIS
    - name: FreeRTOS-Kernel
      revision: MCUX_2.15.100
      remote: nxp-mcuxpresso
      path: nxp-vee-rt595/bsp/mcux-sdk/rtos/freertos/freertos-kernel
  self:
    path: nxp-vee-rt595
```
